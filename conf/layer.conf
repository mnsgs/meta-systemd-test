## conf/layer.conf
```bitbake
# We have a conf and classes directory, add to BBPATH
BBPATH .= ":${LAYERDIR}"

# We have recipes-* directories, add to BBFILES
BBFILES += "${LAYERDIR}/recipes-*/*/*.bb \
            ${LAYERDIR}/recipes-*/*/*.bbappend"

BBFILE_COLLECTIONS += "meta-systemd-test"
BBFILE_PATTERN_meta-systemd-test = "^${LAYERDIR}/"
BBFILE_PRIORITY_meta-systemd-test = "6"

LAYERDEPENDS_meta-systemd-test = "core"
LAYERSERIES_COMPAT_meta-systemd-test = "kirkstone langdale mickledore"
```
